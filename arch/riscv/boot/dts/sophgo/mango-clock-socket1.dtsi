/ {
	s1_cgi_main: oscillator0_s1 {
		compatible = "fixed-clock";
		clock-output-names = "s1_cgi_main";
		#clock-cells = <0>;
		clock-frequency = <25000000>;
	};

	s1_cgi_dpll0: oscillator1_s1 {
		compatible = "fixed-clock";
		clock-output-names = "s1_cgi_dpll0";
		#clock-cells = <0>;
		clock-frequency = <25000000>;
	};

	s1_cgi_dpll1: oscillator2_s1 {
		compatible = "fixed-clock";
		clock-output-names = "s1_cgi_dpll1";
		#clock-cells = <0>;
		clock-frequency = <25000000>;
	};
};
