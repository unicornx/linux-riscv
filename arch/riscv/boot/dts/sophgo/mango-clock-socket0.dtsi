/ {
	cgi_main: oscillator0 {
		compatible = "fixed-clock";
		clock-output-names = "cgi_main";
		#clock-cells = <0>;
		clock-frequency = <25000000>;
	};

	cgi_dpll0: oscillator1 {
		compatible = "fixed-clock";
		clock-output-names = "cgi_dpll0";
		#clock-cells = <0>;
		clock-frequency = <25000000>;
	};

	cgi_dpll1: oscillator2 {
		compatible = "fixed-clock";
		clock-output-names = "cgi_dpll1";
		#clock-cells = <0>;
		clock-frequency = <25000000>;
	};
};
