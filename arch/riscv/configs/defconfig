## drivers/clk/sophgo/Kconfig
```kconfig
# SPDX-License-Identifier: GPL-2.0

config CLK_SOPHGO_SG2042
	bool "Sophgo SG2042 clock support"
	depends on SOC_SOPHGO
	default SOC_SOPHGO
	help
	  Say yes here to support the clock controller on the Sophgo SG2042 SoC.

config CLK_SOPHGO_SG2042_DUMMY
	bool "Sophgo SG2042 dummy clock support"
	depends on CLK_SOPHGO_SG2042
	default n if SOC_SOPHGO
	help
	  Say yes here to enable dummy clock driver support on the Sophgo SG2042
	  SoC.
```
