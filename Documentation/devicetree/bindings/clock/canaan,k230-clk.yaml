## Documentation/devicetree/bindings/clock/canaan,k230-clk.yaml
```yaml
# SPDX-License-Identifier: (GPL-2.0-only OR BSD-2-Clause)
%YAML 1.2
---
$id: http://devicetree.org/schemas/clock/canaan,k230-clk.yaml#
$schema: http://devicetree.org/meta-schemas/core.yaml#

title: Canaan Kendryte K230 Clock

maintainers:
  - Xukai Wang <kingxukai@zohomail.com>

description:
  The Canaan K230 clock controller generates various clocks for SoC
  peripherals. See include/dt-bindings/clock/canaan,k230-clk.h for
  valid clock IDs.

properties:
  compatible:
    const: canaan,k230-clk

  reg:
    items:
      - description: PLL control registers
      - description: Sysclk control registers

  clocks:
    minItems: 1
    items:
      - description: Main external reference clock
      - description: External pulse input

  clock-names:
    minItems: 1
    items:
      - const: osc24m
      - const: timer-pulse-in

  '#clock-cells':
    const: 1

required:
  - compatible
  - reg
  - clocks
  - clock-names
  - '#clock-cells'

additionalProperties: false

examples:
  - |
    clock-controller@91102000 {
        compatible = "canaan,k230-clk";
        reg = <0x91102000 0x40>,
              <0x91100000 0x108>;
        clocks = <&osc24m>;
        clock-names = "osc24m";
        #clock-cells = <1>;
    };
```
